## boards/shields/beryl/Kconfig.defconfig
```kconfig
if SHIELD_MY_KEYBOARD

# Name must be less than 16 characters long!
config ZMK_KEYBOARD_NAME
    default "Beryl ZMK"

endif
CONFIG_BT_CTLR_PHY_2M=n
CONFIG_ZMK_BLE_PASSKEY_ENTRY=y
CONFIG_ZMK_BLE_EXPERIMENTAL_FEATURES=y
```
